## firmware/application/stm32g474/config/Kconfig
```kconfig
mainmenu "Chassis Controller Application"

config CAN
    bool "CAN FD support"
    default y

config ICM45686
    bool "ICM45686 sensor"
    default y

config LCD
    bool "LCD display"
    default y

config QSPI
    bool "QSPI flash"
    default y

config OTA
    bool "OTA support"
    default y

config SELF_TEST
    bool "Board maintenance self-tests"
    default y

config MOTOR_DEMO
    bool "Motor demo"
    default n

config CAN_RX_QUEUE_SIZE
    int
    default 8
    range 2 32

config CONTROL_TASK_STACK_SIZE
    int
    default 512
    range 256 2048

config DIAGNOSTICS_TASK_STACK_SIZE
    int
    default 768
    range 256 2048

config DISPLAY_TASK_STACK_SIZE
    int
    default 512
    range 256 2048

config CONTROL_TASK_PRIORITY
    int
    default 54
    range 0 55

config SERVICE_TASK_PRIORITY
    int
    default 52
    range 0 55

config DIAGNOSTICS_TASK_PRIORITY
    int
    default 51
    range 0 55

config DISPLAY_TASK_PRIORITY
    int
    default 50
    range 0 55

config SERVICE_TASK_PERIOD_MS
    int
    default 1
    range 1 1000

config CONTROL_TASK_PERIOD_MS
    int
    default 10
    range 1 1000

config DIAGNOSTICS_TASK_PERIOD_MS
    int
    default 100
    range 1 10000

config DISPLAY_TASK_PERIOD_MS
    int
    default 1
    range 1 1000

config SERVICE_TASK_TIMEOUT_MS
    int
    default 200
    range 1 60000

config CONTROL_TASK_TIMEOUT_MS
    int
    default 50
    range 1 60000

config DIAGNOSTICS_TASK_TIMEOUT_MS
    int
    default 500
    range 1 60000

config DISPLAY_TASK_TIMEOUT_MS
    int
    default 2000
    range 1 60000
```

## firmware/application/stm32g474/dts/bindings/chassis,buttons.yaml
```yaml
compatible: "chassis,buttons"
required:
  - status
  - gpios
properties:
  status:
    type: string
  gpios:
    type: array
```

## firmware/application/stm32g474/dts/bindings/chassis,emergency-stop.yaml
```yaml
compatible: "chassis,emergency-stop"
required:
  - status
  - gpios
properties:
  status:
    type: string
  gpios:
    type: array
```

## firmware/application/stm32g474/dts/bindings/chassis,leds.yaml
```yaml
compatible: "chassis,leds"
required:
  - status
  - gpios
properties:
  status:
    type: string
  gpios:
    type: array
```

## firmware/application/stm32g474/dts/bindings/chassis,sr501.yaml
```yaml
compatible: "chassis,sr501"
required:
  - status
  - gpios
properties:
  status:
    type: string
  gpios:
    type: array
```

## firmware/application/stm32g474/dts/bindings/chassis,system-time.yaml
```yaml
compatible: "chassis,system-time"
required:
  - status
properties:
  status:
    type: string
```

## firmware/application/stm32g474/dts/bindings/invensense,icm45686.yaml
```yaml
compatible: "invensense,icm45686"
required:
  - status
  - reg
  - frequency
properties:
  reg:
    type: integer
  status:
    type: string
  frequency:
    type: integer
```

## firmware/application/stm32g474/dts/bindings/sitronix,st7789v.yaml
```yaml
compatible: "sitronix,st7789v"
required:
  - status
  - reg
  - width
  - height
properties:
  reg:
    type: integer
  status:
    type: string
  width:
    type: integer
  height:
    type: integer
```

## firmware/application/stm32g474/dts/bindings/st,stm32-adc-power.yaml
```yaml
compatible: "st,stm32-adc-power"
required:
  - status
  - reg
properties:
  reg:
    type: integer
  status:
    type: string
```

## firmware/application/stm32g474/dts/bindings/st,stm32-gpio-port.yaml
```yaml
compatible: "st,stm32-gpio-port"
required:
  - status
properties:
  status:
    type: string
```

## firmware/application/stm32g474/dts/bindings/st,stm32-iwdg.yaml
```yaml
compatible: "st,stm32-iwdg"
required:
  - status
properties:
  status:
    type: string
```

## firmware/application/stm32g474/dts/bindings/st,stm32-pwm-drive.yaml
```yaml
compatible: "st,stm32-pwm-drive"
required:
  - status
  - pwm-period
properties:
  status:
    type: string
  pwm-period:
    type: integer
```

## firmware/application/stm32g474/dts/bindings/st,stm32-rtc.yaml
```yaml
compatible: "st,stm32-rtc"
required:
  - status
properties:
  status:
    type: string
```

## firmware/application/stm32g474/dts/bindings/st,stm32-tim-encoder.yaml
```yaml
compatible: "st,stm32-tim-encoder"
required:
  - status
properties:
  status:
    type: string
```

## firmware/application/stm32g474/dts/bindings/st,stm32-uart.yaml
```yaml
compatible: "st,stm32-uart"
required:
  - status
properties:
  status:
    type: string
```

## firmware/application/stm32g474/dts/bindings/st,stm32g4-fdcan.yaml
```yaml
compatible: "st,stm32g4-fdcan"
required:
  - status
  - bitrate
  - bitrate-data
properties:
  status:
    type: string
  bitrate:
    type: integer
  bitrate-data:
    type: integer
```

## firmware/application/stm32g474/dts/bindings/winbond,w25q64.yaml
```yaml
compatible: "winbond,w25q64"
required:
  - status
  - reg
  - size
  - erase-block-size
  - write-block-size
properties:
  reg:
    type: integer
  status:
    type: string
  size:
    type: integer
  erase-block-size:
    type: integer
  write-block-size:
    type: integer
```
